## meta-emcraft/conf/bblayers.conf.sample
```bitbake
# LAYER_CONF_VERSION is increased each time build/conf/bblayers.conf
# changes incompatibly
LCONF_VERSION = "6"

BBPATH = "${TOPDIR}"
BBFILES ?= ""

BBLAYERS ?= " \
  ##COREBASE##/meta \
  ##COREBASE##/meta-yocto \
  ##COREBASE##/meta-yocto-bsp \
  ##COREBASE##/meta-emcraft \
  "
BBLAYERS_NON_REMOVABLE ?= " \
  ##COREBASE##/meta \
  ##COREBASE##/meta-yocto \
  "

BBMASK = "/meta/recipes-devtools/gcc"
```

## meta-emcraft/conf/layer.conf
```bitbake
# We have a conf and classes directory, add to BBPATH
BBPATH := "${LAYERDIR}:${BBPATH}"

# We have a packages directory, add to BBFILES
BBFILES := "${BBFILES} ${LAYERDIR}/recipes-*/*/*.bb \
            ${LAYERDIR}/recipes-*/*/*.bbappend"

#BBFILE_COLLECTIONS += "core"
#BBFILE_PATTERN_emcraft := "^${LAYERDIR}/"
#BBFILE_PRIORITY_emcraft = "5"
```

## meta-emcraft/conf/machine/vf6-som.conf
```bitbake
#@TYPE: Machine
#@NAME: Emcraft Vybrid VF6-SOM
#@DESCRIPTION: Machine configuration for Emcraft Vf6-SOM board

DEFAULTTUNE ?= "cortexa5hf-neon"

# use defaults for Cortex-A5
require conf/machine/include/tune-cortexa5.inc

# variable needed for compilation
MACHINE_FEATURES ?= ""

PREFERRED_PROVIDER_virtual/kernel ?= "linux-emcraft"
PREFERRED_VERSION_gcc ?= "4.9.3"

# works with new kernel from git
PREFERRED_VERSION_linux-project ?= "4.2%"

# generate uImage variant of linux kernel
KERNEL_IMAGETYPE = "uImage"

# generate flattened device tree
#KERNEL_DEVICETREE = "${MACHINE}.dtb"

# as minimum ubifs format of rootfs is required to program nand memory
#IMAGE_FSTYPES += "ubifs ubi"

IMAGE_FSTYPES = "tar.gz"

MKUBIFS_ARGS = "-m 2048 -e 124KiB -c 1627 -F"

UBINIZE_ARGS = "-m 2048 -p 128KiB"

UBI_VOLNAME = "rootfs"
# use specific u-boot from git
#EXTRA_IMAGEDEPENDS += "u-boot-emcraft"

# config of u-boot to be used
#UBOOT_MACHINE = "vybrid_som_config"

# parameters for sysvinit inittab
SERIAL_CONSOLE = "115200 ttymxc0"
# SYSVINIT_ENABLED_GETTYS = 0
# USE_VT = 0
```
